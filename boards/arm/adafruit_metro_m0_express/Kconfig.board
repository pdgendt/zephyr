## boards/arm/adafruit_metro_m0_express/Kconfig.board
```kconfig
# Adafruit Metro M0 Express board configuration

# Copyright (c) 2022, Pieter De Gendt <pieter.degendt@gmail.com>
# SPDX-License-Identifier: Apache-2.0

config BOARD_ADAFRUIT_METRO_M0_EXPRESS
	bool "Adafruit Metro M0 Express"
	depends on SOC_PART_NUMBER_SAMD21G18A
```

## boards/arm/adafruit_metro_m0_express/Kconfig.defconfig
```kconfig
# Adafruit Metro M0 Express board configuration

# Copyright (c) 2022 Pieter De Gendt <pieter.degendt@gmail.com>
# SPDX-License-Identifier: Apache-2.0

config BOARD
	default "adafruit_metro_m0_express"
	depends on BOARD_ADAFRUIT_METRO_M0_EXPRESS
```

## drivers/kscan/Kconfig.tt21x
```kconfig
# Copyright (c) 2021 Basalte
# SPDX-License-Identifier: Apache-2.0

menuconfig KSCAN_TT21X
	bool "TT21XXX TrueTouch capacitive touch panel driver"
	depends on I2C
	help
	  Enable driver for Parade tech capacitive touch panel
	  controllers.

if KSCAN_TT21X

config KSCAN_TT21X_PERIOD
	int "Sample period"
	depends on !KSCAN_TT21X_INTERRUPT
	default 10
	help
	  Sample period in milliseconds when in polling mode.

config KSCAN_TT21X_INTERRUPT
	bool "Enable interrupt"
	help
	  Enable interrupt support (requires GPIO).

endif # KSCAN_TT21X
```

## drivers/nfc/Kconfig
```kconfig
# NFC configuration options
#
# Copyright (c) 2023 Basalte bv
# SPDX-License-Identifier: Apache-2.0

#
# NFC options
#
menuconfig NFC
	bool "Near Field Communication (NFC) drivers [EXPERIMENTAL]"
	select EXPERIMENTAL
	help
	  Enable NFC Driver Configuration.

if NFC

module = NFC
module-str = NFC
source "subsys/logging/Kconfig.template.log_config"

config NFC_INIT_PRIORITY
	int "NFC driver init priority"
	default 80
	help
	  NFC driver device initialization priority.

source "drivers/nfc/Kconfig.pn5180"

endif # NFC
```

## drivers/nfc/Kconfig.pn5180
```kconfig
# NXP PN5180 NFC HCI driver configuration options
#
# Copyright (c) 2023 Basalte bv
# SPDX-License-Identifier: Apache-2.0

menuconfig NFC_PN5180
	bool "NXP PN5180"
	default y
	depends on DT_HAS_NXP_PN5180_ENABLED
	select GPIO
        select SPI
	help
	  Enable NXP PN5180 NFC HCI driver.
```

## drivers/pwm/Kconfig.mcux_ipwm
```kconfig
# NXP IPWM configuration options

# Copyright (c) 2024 Basalte bv
# SPDX-License-Identifier: Apache-2.0

config PWM_MCUX_IPWM
	bool "MCUX IPWM driver"
	default y
	depends on DT_HAS_NXP_IMX_IPWM_ENABLED
	depends on CLOCK_CONTROL
	select PINCTRL
	help
	  Enable the MCUX IPWM driver.
```

## drivers/reset/Kconfig.gpio
```kconfig
# Copyright (c) 2025 Basalte bv
# SPDX-License-Identifier: Apache-2.0

config RESET_GPIO
	bool "GPIO reset driver"
	default y
	depends on DT_HAS_ZEPHYR_GPIO_RESET_ENABLED
	help
	  This option enables the reset driver using GPIO pins.
```

## drivers/rtc/Kconfig.nxp_imx_snvs
```kconfig
# Copyright 2025 Basalte bv
# SPDX-License-Identifier: Apache-2.0

config RTC_NXP_IMX_SNVS
	bool "NXP i.MX SNVS Real Time Clock driver"
	default y
	depends on DT_HAS_NXP_IMX_SNVS_RTC_ENABLED
```

## drivers/sensor/microchip/pac1921/Kconfig
```kconfig
# Microchip PAC1921 Power/Current Monitor
#
# Copyright (c) 2025 Basalte bv
#
# SPDX-License-Identifier: Apache-2.0

config PAC1921
	bool "PAC1921 Power/Current Monitor"
	default y
	depends on DT_HAS_MICROCHIP_PAC1921_ENABLED
	select I2C
	help
	  Enables driver for High-Side Power/Current Monitor with Analog Output.

if PAC1921

config PAC1921_STREAM
	bool "PAC1921 data streaming"
	default y
	depends on I2C_RTIO
	depends on SENSOR_ASYNC_API

config PAC1921_TRIGGER
	bool

endif
```

## drivers/spi/Kconfig.mcux_ecspi
```kconfig
# MCUXpresso SDK SPI

# Copyright (c) 2022, Basalte bv
# SPDX-License-Identifier: Apache-2.0

config SPI_MCUX_ECSPI
	bool "MCUX ECSPI driver"
	depends on HAS_MCUX_ECSPI && CLOCK_CONTROL
	help
	  Enable support for mcux ecspi driver.

if SPI_MCUX_ECSPI

config SPI_MCUX_ECSPI_MAX_TRANSFER_SIZE
	int "MCUX ECSPI driver max transfer size"
	default 32
	help
	  This driver requires an uint32_t internal buffer
	  for each transfer. Set this to the maximum number
	  of words to be sent.

endif
```

## drivers/spi/Kconfig.sam
```kconfig
# Atmel SAM SPI

# Copyright (c) 2019 Gerson Fernando Budke
# Copyright (c) 2018 qianfan Zhao
# SPDX-License-Identifier: Apache-2.0

config SPI_SAM
	bool "Atmel SAM series SPI driver"
	default y
	depends on DT_HAS_ATMEL_SAM_SPI_ENABLED
	select GPIO
	help
	  Enable support for the SAM SPI driver.

if SPI_SAM

config SPI_SAM_DMA
	bool "SPI SAM DMA Support"
	select DMA
	help
	  Enable using DMA with SPI for SPI instances that enable dma channels in
	  their device tree node.

config SPI_SAM_DMA_THRESHOLD
	int "SPI SAM DMA Threshold"
	default 32
	depends on SPI_SAM_DMA
	help
	  Number of bytes in transfer before using DMA if available.

config SPI_SAM_INTERRUPT
	bool "SPI SAM Interrupt Mode"
	default y if SPI_ASYNC
	help
	  Enable SPI transfers using interrupts instead of blocking requests.

endif # SPI_SAM
```

## drivers/spi/Kconfig.spi_generic
```kconfig
# Copyright 2021 Basalte bv
# SPDX-License-Identifier: Apache-2.0

config SPI_GENERIC
	bool "SPI generic device"
	help
	  Enable the SPI generic device driver, allowing to set up simple
	  communication with optional interrupt and reset gpios.
```

## drivers/syscon/Kconfig.zephyr_ram
```kconfig
# Copyright (c) 2025 Basalte bv
# SPDX-License-Identifier: Apache-2.0

config SYSCON_ZEPHYR_RAM
	bool "SYSCON driver with RAM backend"
	default y
	depends on DT_HAS_ZEPHYR_SYSCON_RAM_ENABLED
```

## dts/bindings/hwinfo/zephyr,gpio-revison.yaml
```yaml
# Copyright (c) 2022, Basalte bv
# SPDX-License-Identifier: Apache-2.0

description: zephyr GPIO controlled revision indicator

compatible: "zephyr,gpio-revision"

include: base.yaml

properties:
    gpios:
      type: phandle-array
      required: true
      description: |
        Pins used to determine revision number.
        Each gpio corresponds to a single bit in the revision number,
        in order from MSB to LSB.
```

## dts/bindings/kscan/paradetech,tt21x.yaml
```yaml
# Copyright (c) 2021 Basalte bv
# SPDX-License-Identifier: Apache-2.0

description: TT21X capacitive touch panels

compatible: "paradetech,tt21x"

include: [kscan.yaml, i2c-device.yaml]

properties:
    reset-gpios:
      type: phandle-array
      required: true
    int-gpios:
      type: phandle-array
      required: false
```

## dts/bindings/nfc/nfc-controller.yaml
```yaml
# Copyright (c) 2023 Basalte bv
# SPDX-License-Identifier: Apache-2.0

description: Common fields for NFC controllers

include: [base.yaml]
```

## dts/bindings/nfc/nxp,pn5180.yaml
```yaml
# Copyright (c) 2023 Basalte bv
# SPDX-License-Identifier: Apache-2.0

description: NXP PN5180 NFC Controller on SPI bus

compatible: "nxp,pn5180"

include: [nfc-controller.yaml, spi-device.yaml]

properties:
  busy-gpios:
    type: phandle-array
    required: true
    description: |
      The BUSY line is used to indicate that the system is
      processing data and cannot receive any data from a host.

  irq-gpios:
    type: phandle-array
    required: true
    description: |
      The IRQ_ENABLE configures, which of the interrupts are
      routed to the IRQ pin of the PN5180. All of the interrupts
      can be enabled and disabled independent from each other.

  reset-gpios:
    type: phandle-array
    description: GPIO for reset
```

## dts/bindings/pwm/nxp,imx-ipwm.yaml
```yaml
# Copyright (c) 2024, Basalte bv
# SPDX-License-Identifier: Apache-2.0

description: |
    This binding gives a base representation of the NXP iMX IPWM

compatible: "nxp,imx-ipwm"

include: [pwm-controller.yaml, pinctrl-device.yaml, base.yaml]

properties:
  reg:
    required: true

  clocks:
    required: true

  pinctrl-0:
    required: true

  pinctrl-names:
    required: true

  prescaler:
    type: int
    required: true
    description: |
      Clock prescaler at the input of the PWM in range [1-4096].

  rdc:
    type: int
    description: Set the RDC permission for this peripheral

  run-in-wait:
    type: boolean
    description: |
      Enable for PWM to keep running in WAIT mode.

  run-in-debug:
    type: boolean
    description: |
      Enable for PWM to keep running in debug mode.

  "#pwm-cells":
    const: 2

pwm-cells:
  - period
  - flags
```

## dts/bindings/reset/zephyr,gpio-reset.yaml
```yaml
# Copyright (c) 2025, Basalte bv
# SPDX-License-Identifier: Apache-2.0

description: |
  GPIO reset controller.

compatible: "zephyr,gpio-reset"

include: [reset-controller.yaml, base.yaml]

properties:
  "#reset-cells":
    const: 1

  assert-time:
    type: int
    description: |
      The optional time in milliseconds to sleep after asserting the reset.

  deassert-time:
    type: int
    description: |
      The optional time in milliseconds to sleep after deasserting the reset.

reset-cells:
  - id
```

## dts/bindings/sensor/microchip,pac1921.yaml
```yaml
# Copyright (c) 2025 Basalte bv
# SPDX-License-Identifier: Apache-2.0

title: PAC1921 Power/Current Monitor

description: |
  The PAC1921 is a dedicated power-monitoring device with a configurable
  analog output that can present power, current or voltage.

  For more information: https://www.microchip.com/en-us/product/pac1921

compatible: "microchip,pac1921"

include: [sensor-device.yaml, i2c-device.yaml]

properties:
  read-int-gpios:
    type: phandle-array
    description: |
      READ/INT pin to control power states.
      The inactive level puts the device in a READ state (low power).
```

## dts/bindings/spi/nxp,imx-ecspi.yaml
```yaml
# Copyright (c) 2022, Basalte bv
# SPDX-License-Identifier: Apache-2.0

description: NXP i.MX ECSPI controller

compatible: "nxp,imx-ecspi"

include: spi-controller.yaml

properties:
    reg:
      required: true

    interrupts:
      required: true

    clocks:
      required: true
```

## dts/bindings/spi/zephyr,spi-generic.yaml
```yaml
# Copyright 2021 Basalte bv
# SPDX-License-Identifier: Apache-2.0

description: Zephyr SPI Generic device

compatible: "zephyr,spi-generic"

include: spi-device.yaml

properties:
    int-gpios:
      type: phandle-array
      required: false
    reset-gpios:
      type: phandle-array
      required: false
    spi-slave:
      type: boolean
      required: false
      description: |
        Empty property indicating device is slave mode
    spi-cpol:
      type: boolean
      required: false
      description: |
        Empty property indicating device requires
        inverse clock polarity (CPOL) mode
    spi-cpha:
      type: boolean
      required: false
      description: |
        Empty property indicating device requires
        shifted clock phase (CPHA) mode
    spi-loop:
      type: boolean
      required: false
      description: |
        Empty property indicating device sends data
        looped-back to receiving buffer
    spi-lsb-first:
      type: boolean
      required: false
      description: |
        Empty property indicating device requires
        LSB first mode.
    spi-cs-high:
      type: boolean
      required: false
      description: |
        Empty property indicating device requires
        chip select active high
    spi-cs-delay:
      type: int
      required: false
      default: 0
      description: |
        Delay in microseconds to wait before starting the
        transmission and before releasing the CS line
    spi-bus-width:
      type: int
      required: false
      default: 1
      description: |
        The bus width (number of data wires) that is
        used for MISO. Defaults to 1 if not present.
      enum:
        - 1
        - 2
        - 4
        - 8
    spi-bits-per-word:
      type: int
      required: false
      description: |
        Word size for a data transfer. Defaults to 8
        if not present
```

## dts/bindings/syscon/zephyr,syscon-ram.yaml
```yaml
# Copyright (c) 2025 Basalte bv
# SPDX-License-Identifier: Apache-2.0

description: System Controller Registers R/W with a RAM backend

compatible: "zephyr,syscon-ram"

include: base.yaml

properties:
  reg-io-width:
    type: int
    description: The width of the registers in the syscon region in bytes. Default is 4 bytes.

  size:
    required: true
    type: int
    description: Size of RAM buffer (bytes)
```

## subsys/nfc/Kconfig
```kconfig
# NFC Subsystem configuration options

# Copyright (c) 2023 Basalte bv
# SPDX-License-Identifier: Apache-2.0

menu "Near Field Communication (NFC) subsystem [EXPERIMENTAL]"

source "subsys/nfc/Kconfig.iso14443"

endmenu
```

## subsys/nfc/Kconfig.iso14443
```kconfig
# NFC ISO14443 configuration options

# Copyright (c) 2023 Basalte bv
# SPDX-License-Identifier: Apache-2.0

menuconfig NFC_ISO14443
	bool "NFC ISO/IEC 14443"
	select EXPERIMENTAL
	help
	  Configuration options for ISO/IEC 14443.

if NFC_ISO14443

module = NFC_ISO14443
module-str = NFC_ISO14443
source "subsys/logging/Kconfig.template.log_config"

config NFC_ISO14443A
	bool "NFC ISO/IEC 14443 Type A"
	default y
	help
	  Enable ISO/IEC 14443 Type A support for NFC.

choice NFC_ISO14443_FSC
	prompt "Type 4A Tag Maximum Frame Size in Listen Mode"
	default NFC_ISO14443_FSC_32
	help
	  The FSC defines the maximum size of a frame accepted
	  by the NFC Forum Device in Listen Mode. FSC is expressed
	  in number of data bytes included in the frame.

config NFC_ISO14443_FSC_16
	bool "FSC 16"
config NFC_ISO14443_FSC_24
	bool "FSC 24"
config NFC_ISO14443_FSC_32
	bool "FSC 32"
config NFC_ISO14443_FSC_40
	bool "FSC 40"
config NFC_ISO14443_FSC_48
	bool "FSC 48"
config NFC_ISO14443_FSC_64
	bool "FSC 64"
config NFC_ISO14443_FSC_96
	bool "FSC 96"
config NFC_ISO14443_FSC_128
	bool "FSC 128"
config NFC_ISO14443_FSC_256
	bool "FSC 256"

endchoice # NFC_ISO14443_FSC

config NFC_ISO14443_FSC_MAX
	int
	default 16 if NFC_ISO14443_FSC_16
	default 24 if NFC_ISO14443_FSC_24
	default 32 if NFC_ISO14443_FSC_32
	default 40 if NFC_ISO14443_FSC_40
	default 48 if NFC_ISO14443_FSC_48
	default 64 if NFC_ISO14443_FSC_64
	default 96 if NFC_ISO14443_FSC_96
	default 128 if NFC_ISO14443_FSC_128
	default 256 if NFC_ISO14443_FSC_256

config NFC_ISO14443_FSCI
	hex
	default 0x00 if NFC_ISO14443_FSC_16
	default 0x01 if NFC_ISO14443_FSC_24
	default 0x02 if NFC_ISO14443_FSC_32
	default 0x03 if NFC_ISO14443_FSC_40
	default 0x04 if NFC_ISO14443_FSC_48
	default 0x05 if NFC_ISO14443_FSC_64
	default 0x06 if NFC_ISO14443_FSC_96
	default 0x07 if NFC_ISO14443_FSC_128
	default 0x08 if NFC_ISO14443_FSC_256
	help
	  Frame Size for proximity Card Integer in Listen Mode

choice NFC_ISO14443_FSD
	prompt "Type 4A Tag Maximum Frame Size in Poll Mode"
	default NFC_ISO14443_FSD_24
	help
	  The FSD defines the maximum size of a frame that the NFC Forum Device
	  in Poll Mode is able to receive. FSD is expressed in number of data bytes
	  included in the frame.

config NFC_ISO14443_FSD_16
	bool "FSC 16"
config NFC_ISO14443_FSD_24
	bool "FSC 24"
config NFC_ISO14443_FSD_32
	bool "FSC 32"
config NFC_ISO14443_FSD_40
	bool "FSC 40"
config NFC_ISO14443_FSD_48
	bool "FSC 48"
config NFC_ISO14443_FSD_64
	bool "FSC 64"
config NFC_ISO14443_FSD_96
	bool "FSC 96"
config NFC_ISO14443_FSD_128
	bool "FSC 128"
config NFC_ISO14443_FSD_256
	bool "FSC 256"

endchoice # NFC_ISO14443_FSD

config NFC_ISO14443_FSD_MAX
	int
	default 16 if NFC_ISO14443_FSD_16
	default 24 if NFC_ISO14443_FSD_24
	default 32 if NFC_ISO14443_FSD_32
	default 40 if NFC_ISO14443_FSD_40
	default 48 if NFC_ISO14443_FSD_48
	default 64 if NFC_ISO14443_FSD_64
	default 96 if NFC_ISO14443_FSD_96
	default 128 if NFC_ISO14443_FSD_128
	default 256 if NFC_ISO14443_FSD_256

config NFC_ISO14443_FSDI
	hex
	default 0x00 if NFC_ISO14443_FSD_16
	default 0x10 if NFC_ISO14443_FSD_24
	default 0x20 if NFC_ISO14443_FSD_32
	default 0x30 if NFC_ISO14443_FSD_40
	default 0x40 if NFC_ISO14443_FSD_48
	default 0x50 if NFC_ISO14443_FSD_64
	default 0x60 if NFC_ISO14443_FSD_96
	default 0x70 if NFC_ISO14443_FSD_128
	default 0x80 if NFC_ISO14443_FSD_256
	help
	  Frame Size for proximity Card Integer in Poll Mode

endif # NFC_ISO14443
```

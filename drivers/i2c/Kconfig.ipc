## drivers/i2c/Kconfig.ipc
```kconfig
# SPDX-FileCopyrightText: 2026 Basalte bv
# SPDX-License-Identifier: Apache-2.0

config I2C_IPC
	bool "I2C over IPC (client proxy)"
	default y
	depends on DT_HAS_ZEPHYR_I2C_IPC_ENABLED
	select IPC_SERVICE
	help
	  Enable the I2C IPC proxy client driver. This creates a virtual
	  I2C controller that forwards all operations over IPC to a
	  server running on another CPU.

if I2C_IPC

config I2C_IPC_INIT_PRIORITY
	int "I2C IPC client init priority"
	default 51
	help
	  I2C IPC client driver initialization priority.
	  Must be after the IPC backend initialization.

config I2C_IPC_BUFFER_SIZE
	int "I2C IPC transfer buffer size"
	default 256
	help
	  Maximum buffer size in bytes for serialized I2C messages.
	  Must accommodate the protocol header plus all message data.

endif # I2C_IPC

config I2C_IPC_SERVER
	bool "I2C over IPC (server)"
	default y
	depends on DT_HAS_ZEPHYR_I2C_IPC_SERVER_ENABLED
	select IPC_SERVICE
	help
	  Enable the I2C IPC proxy server driver. This receives I2C
	  operations over IPC and forwards them to a real I2C controller.

if I2C_IPC_SERVER

config I2C_IPC_SERVER_INIT_PRIORITY
	int "I2C IPC server init priority"
	default 51
	help
	  I2C IPC server driver initialization priority.
	  Must be after both the IPC backend and the real I2C controller.

config I2C_IPC_SERVER_BUFFER_SIZE
	int "I2C IPC server buffer size"
	default 256
	help
	  Maximum buffer size in bytes for serialized I2C messages.

config I2C_IPC_SERVER_STACK_SIZE
	int "I2C IPC server thread stack size"
	default 1024
	help
	  Stack size for the I2C IPC server processing thread.

endif # I2C_IPC_SERVER
```

## dts/bindings/i2c/zephyr,i2c-ipc-server.yaml
```yaml
# SPDX-FileCopyrightText: 2026 Basalte bv
# SPDX-License-Identifier: Apache-2.0

description: |
  I2C IPC server - receives I2C operations over IPC and forwards them to a
  real I2C controller.

  This node must be a child of an IPC service instance. Both the client and
  server must use the same endpoint name for binding to succeed.

examples:
  - |
    #include <zephyr/dt-bindings/i2c/i2c.h>

    ipc {
      i2c-ipc-server {
        compatible = "zephyr,i2c-ipc-server";
        controller = <&i2c0>;
        status = "okay";
      };
    };

compatible: "zephyr,i2c-ipc-server"

include: base.yaml

properties:
  controller:
    type: phandle
    required: true
    description: |
      Phandle to the real I2C controller that this server forwards
      operations to.
  ipc-endpoint-name:
    type: string
    default: "i2c_ipc"
    description: |
      IPC endpoint name used when registering with the parent IPC service
      instance. Must match the endpoint name on the corresponding client.
```

## dts/bindings/i2c/zephyr,i2c-ipc.yaml
```yaml
# SPDX-FileCopyrightText: 2026 Basalte bv
# SPDX-License-Identifier: Apache-2.0

description: |
  I2C controller proxy over IPC.

  Creates a virtual I2C bus that forwards all operations over an IPC endpoint
  to a server running on another MCU (or CPU). The server executes the
  operations on a real I2C controller.

  This node must be a child of an IPC service instance. Both the client and
  server must use the same endpoint name for binding to succeed.

  Example usage (client side):

  ::

    +------------------+                    +-------------------+
    | app / sensor drv |                    |                   |
    |       |          |                    |                   |
    | [i2c_ipc client] |--IPC endpoint---->| [i2c_ipc server]  |
    |  (I2C controller)|                    |       |           |
    +------------------+                    |   [real i2c ctrl] |
                                            +-------------------+

examples:
  - |
    &ipc0 {
      i2c_proxy: i2c-ipc {
        compatible = "zephyr,i2c-ipc";
        #address-cells = <1>;
        #size-cells = <0>;
        status = "okay";

        sensor@48 {
          compatible = "ti,tmp116";
          reg = <0x48>;
        };
      };
    };

compatible: "zephyr,i2c-ipc"

include: i2c-controller.yaml

properties:
  ipc-endpoint-name:
    type: string
    default: "i2c_ipc"
    description: |
      IPC endpoint name used when registering with the parent IPC service
      instance. Must match the endpoint name on the corresponding server.
```

## tests/kernel/device_lock/testcase.yaml
```yaml
common:
  tags:
    - device
    - kernel
tests:
  kernel.device_lock:
    integration_platforms:
      - native_sim
  kernel.device_lock.disabled:
    integration_platforms:
      - native_sim
    extra_configs:
      - CONFIG_DEVICE_API_LOCK=n
```

## tests/net/rtp/loopback/Kconfig
```kconfig
# SPDX-FileCopyrightText: 2026 Basalte bv
# SPDX-License-Identifier: Apache-2.0

config RTP_LOOPBACK_TEST_SRTP_GCM
	bool "Use AES-GCM for the SRTP loopback permutations"
	help
	  Protect the loopback session with AES-128-GCM instead of
	  AES-128-CM with HMAC-SHA1-80.

source "Kconfig.zephyr"
```
